// SPDX-License-Identifier: Apache-2.0
// Copyright (C) 2026 RadicalES
//
// ROCK 5B: switch off the SDIO controller (the M.2 E-key's SDIO lines).
// Upstream marks it non-removable, so every boot probes it at four clock rates;
// with a PCIe module in the slot, or none, each attempt times out
// ("fe2d0000.mmc: Busy", "mmc2: Timeout sending command"). This port supports no
// SDIO module, so the controller has nothing to do. Applied by U-Boot
// (extlinux fdtoverlays); drop it here if an SDIO module is ever supported.

/dts-v1/;
/plugin/;

/ {
	fragment0 {
		target-path = "/mmc@fe2d0000";
		__overlay__ {
			status = "disabled";
		};
	};
};
